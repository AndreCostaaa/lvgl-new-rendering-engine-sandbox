## conf/linux/nanovg.defconfig
```kconfig
CONFIG_LV_USE_DRAW_NANOVG=y
CONFIG_LV_USE_OPENGLES_PBUFFER=y
CONFIG_LV_DRAW_BUF_STRIDE_ALIGN=1
CONFIG_LV_USE_GLTF=y
```

## conf/linux/opengles.defconfig
```kconfig
CONFIG_LV_USE_DRAW_OPENGLES=y
CONFIG_LV_USE_SDL=y
CONFIG_LV_SDL_BACKEND_EGL=y
CONFIG_LV_USE_GLTF=y
# CONFIG_LV_SDL_AUTO_BACKEND is not set
```

## conf/linux/vg_lite.defconfig
```kconfig
CONFIG_LV_USE_DRAW_VG_LITE=y
CONFIG_LV_USE_VG_LITE_THORVG=y
CONFIG_LV_USE_THORVG_INTERNAL=y
CONFIG_LV_DRAW_TRANSFORM_USE_MATRIX=y
CONFIG_LV_VG_LITE_USE_BOX_SHADOW=y
CONFIG_LV_DRAW_BUF_ALIGN=64
CONFIG_LV_USE_VECTOR_GRAPHIC=y
```

## west.yml
```yaml
manifest:
  remotes:
    - name: zephyrproject-rtos
      url-base: https://github.com/zephyrproject-rtos

  projects:
    - name: zephyr
      remote: zephyrproject-rtos
      revision: v4.5.0-rc2
      import:
        name-allowlist:
          - cmsis_6
          - hal_espressif
          - hal_nxp
          - hal_renesas
          - hal_sifli
          - hal_stm32
          - lvgl
          - picolibc

  self:
    path: sandbox
```
